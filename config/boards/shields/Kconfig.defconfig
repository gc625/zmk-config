## config/boards/shields/Kconfig.defconfig
```kconfig
if SHIELD_MY_CORNE

# Name must be less than 16 characters long!
config ZMK_KEYBOARfD_NAME
    default "My Keyboard"

config ZMK_SPLIT_ROLE_CENTRAL
    default y

endif

if SHIELD_CORNE_LEFT || SHIELD_CORNE_RIGHT

config ZMK_SPLIT
    default y

endif
```
